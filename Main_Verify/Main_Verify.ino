#include <Adafruit_Fingerprint.h>

// pin #19 is IN from sensor (GREEN wire)
// pin #18 is OUT from arduino  (WHITE wire)

#define mySerial Serial1
#define led1 24
#define led2 25
#define PIR_Sensor 40


// this constant won't change:
const int  buttonPin = 12;    // the pin that the pushbutton is attached to
const int buzzer = 34;                // choose the pin for the buzzer
const int relay = 8;           //relay pin

// Variables will change:
int buttonPushCounter = 0;   // counter for the number of button presses
int buttonState = 0;         // current state of the button
int lastButtonState = 0;     // previous state of the button

Adafruit_Fingerprint finger = Adafruit_Fingerprint(&mySerial);
int fingerprintID = 0;

void setup()
{
  // initialize the button pin as a input:
  pinMode(buttonPin, INPUT_PULLUP);
  pinMode(relay, OUTPUT); 
  pinMode(buzzer, OUTPUT);
  pinMode(led1, OUTPUT); 
  pinMode(led2, OUTPUT);
  pinMode(PIR_Sensor, INPUT);
  
  // initialize serial communication:
  Serial.begin(9600);
  while (!Serial);  // For Yun/Leo/Micro/Zero/...
  delay(100);

  // set the data rate for the sensor serial port
  finger.begin(57600);
  delay(5);
  if (finger.verifyPassword()) {
    Serial.println("Found fingerprint sensor!");
  } else {
    Serial.println("Did not find fingerprint sensor :(");
    while (1) { delay(1); }
  }

  finger.getTemplateCount();

  if (finger.templateCount == 0) {
    Serial.print("Sensor doesn't contain any fingerprint data. Please run the 'enroll' example.");
  }
  else {
    Serial.println("Waiting for valid finger...");
    Serial.print("Sensor contains "); Serial.print(finger.templateCount); Serial.println(" templates");
  }
}

void loop()                     // run over and over again
{
  int fingerprintID = 0;
  digitalWrite(led1, HIGH);    //turn Led on
  digitalWrite(PIR_Sensor, LOW);     //initialaize motion sensor as off
  digitalWrite(buzzer, LOW);      //initialize buzzer to be turned off
  digitalWrite(relay, HIGH);       //set relay high, which means solenoid is locked  
  
  //Call the getFingerprintIDez() function to very if the scanned fingerpirnt is valid.
  //If we recognize the fingerprint, (Id 1 and 2) then unlock the solenoid for some seconds
  fingerprintID = getFingerprintIDez();
  delay(50);
  if(fingerprintID == 1 || fingerprintID == 2){
  digitalWrite(relay, LOW);
  delay(4000);
  digitalWrite(relay, HIGH);         
  }
  
    // read the pushbutton input pin:
  buttonState = digitalRead(buttonPin);

  // compare the buttonState to its previous state
  if (buttonState != lastButtonState) {
    // if the state has changed, increment the counter
    if (buttonState == HIGH) {
      // if the current state is HIGH then the button went from off to on:
      buttonPushCounter++;
      Serial.println("on");
      Serial.print("number of button pushes: ");
      Serial.println(buttonPushCounter);
    } else {
      // if the current state is LOW then the button went from on to off:
      Serial.println("off");
    }
    // Delay a little bit to avoid bouncing
    delay(50);
  }
  // save the current state as the last state, for next time through the loop
  lastButtonState = buttonState;


  // turns on the LED when the button is pushed by checking the modulo of the
  // button push counter. the modulo function gives you the remainder of the
  // division of two numbers:
  if (buttonPushCounter % 2 == 0) {
    Serial.println("Motion Sensor active");
    digitalWrite(led1, LOW); 
    //turn on second Led to indicate motion sensor is active
    digitalWrite(led2, HIGH); 
    delay(1000);
    
    //only leave loop and turn off motion sensor when a valid fingerprint 
    //is scanned
    while (getFingerprintIDez() == -1){   
      
      //checks if PIR sensor detects motion
      if (digitalRead(PIR_Sensor) == HIGH){
        Serial.println("Motion Detected!");
        delay(1000);
        //buzzer alarms user if there is an intruder closeby
        digitalWrite(buzzer, HIGH); 
      }
    }
    delay(2000);
    Serial.println("Motion Sensor deactivated!");
    buttonPushCounter = 1;
  } 
  else {
    digitalWrite(led2, LOW);  //motion sensor is no longer active
    delay(1000);
    digitalWrite(led1, HIGH);
  }
             
}

  
//verifies if the scanned fingerprint is valid
//returns -1 if failed, otherwise returns ID # of the fingerprint
int getFingerprintIDez() {
  
  //Asks the sensor to take an image of the fingerprint
  uint8_t p = finger.getImage();
  if (p != FINGERPRINT_OK)
  return -1;

  //Asks the sensor to convert image to feature template
  p = finger.image2Tz();
  if (p != FINGERPRINT_OK)
  return -1;

  //Asks the sensor to search current scanned fingerprint and match to 
  //saved feature IDs
  p = finger.fingerFastSearch();
  if (p != FINGERPRINT_OK)  
  return -1;
  
    // found a match!
  Serial.print("Found ID #"); Serial.print(finger.fingerID);
  Serial.print(" with confidence of "); Serial.println(finger.confidence);
  return finger.fingerID;  //ID number of found fingerprint
}
